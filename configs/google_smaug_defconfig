## configs/google_smaug_defconfig
```kconfig
CONFIG_ANY_TOOLCHAIN=y
CONFIG_USE_BLOBS=y
CONFIG_VENDOR_GOOGLE=y
# CONFIG_POST_DEVICE is not set
CONFIG_COREBOOT_ROMSIZE_KB_1024=y
CONFIG_CONSOLE_SERIAL_TEGRA210_UARTA=y
CONFIG_HAVE_MTC=y
CONFIG_HAVE_MTC_TABLES=y
CONFIG_MTC_TABLES_DIRECTORY="../shofel2/smaug_mtc_tables"
CONFIG_DEFAULT_CONSOLE_LOGLEVEL_8=y
CONFIG_PAYLOAD_ELF=y
CONFIG_PAYLOAD_FILE="../u-boot/u-boot.elf"
```
